## build/Kconfig/arch/Kconfig
```kconfig
# Load Zephyr Arch Kconfig descriptions.
osource "D:/Projects/Gemini01/zephyrproject/zephyr/arch/rx/Kconfig"
osource "D:/Projects/Gemini01/zephyrproject/zephyr/arch/x86/Kconfig"
osource "D:/Projects/Gemini01/zephyrproject/zephyr/arch/xtensa/Kconfig"
osource "D:/Projects/Gemini01/zephyrproject/zephyr/arch/sparc/Kconfig"
osource "D:/Projects/Gemini01/zephyrproject/zephyr/arch/riscv/Kconfig"
osource "D:/Projects/Gemini01/zephyrproject/zephyr/arch/posix/Kconfig"
osource "D:/Projects/Gemini01/zephyrproject/zephyr/arch/mips/Kconfig"
osource "D:/Projects/Gemini01/zephyrproject/zephyr/arch/arm64/Kconfig"
osource "D:/Projects/Gemini01/zephyrproject/zephyr/arch/arm/Kconfig"
osource "D:/Projects/Gemini01/zephyrproject/zephyr/arch/arc/Kconfig"
```

## build/Kconfig/boards/Kconfig
```kconfig
# Load Zephyr board Kconfig descriptions.
osource "D:/Projects/Gemini01/zephyrproject/zephyr/boards/others/stm32_min_dev/Kconfig"
config BOARD_REVISION_BLUE
	def_bool y
```

## build/Kconfig/boards/Kconfig.stm32_min_dev
```kconfig
# Load board Kconfig descriptions.
osource "D:/Projects/Gemini01/zephyrproject/zephyr/boards/others/stm32_min_dev/Kconfig.stm32_min_dev"
```

## build/Kconfig/boards/Kconfig.sysbuild
```kconfig
# Load Sysbuild board Kconfig descriptions.
osource "D:/Projects/Gemini01/zephyrproject/zephyr/boards/others/stm32_min_dev/Kconfig.sysbuild"
```
